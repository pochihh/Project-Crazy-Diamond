/**
 * @cliArgs --device "F2837xD" --part "F2837xD_100PTP" --package "F2837xD_100PTP" --context "CPU1" --product "C2000WARE@6.00.00.00"
 * @versions {"tool":"1.25.0+4268"}
 */

/**
 * Import the modules used in this configuration.
 */
const cla    = scripting.addModule("/driverlib/cla.js", {}, false);
const cla1   = cla.addInstance();
const memcfg = scripting.addModule("/driverlib/memcfg.js");

/**
 * Write custom configuration values to the imported modules.
 */
cla1.enable_CLA_TASK_2                     = false;
cla1.enable_CLA_TASK_3                     = false;
cla1.enable_CLA_TASK_4                     = false;
cla1.enable_CLA_TASK_5                     = false;
cla1.enable_CLA_TASK_6                     = false;
cla1.enable_CLA_TASK_7                     = false;
cla1.$name                                 = "myCLA1";
cla1.cpuint_CLA_TASK_2                     = false;
cla1.cpuint_CLA_TASK_3                     = false;
cla1.cpuint_CLA_TASK_4                     = false;
cla1.cpuint_CLA_TASK_5                     = false;
cla1.cpuint_CLA_TASK_6                     = false;
cla1.cpuint_CLA_TASK_7                     = false;
cla1.cpuint_CLA_TASK_8                     = false;
cla1.enable_CLA_TASK_8                     = false;
cla1.intconfig_CLA_TASK_1.interruptHandler = "CLA1_Task_1_ISR";

memcfg.config_MEMCFG_SECT_LS4        = "CLA_data";
memcfg.config_MEMCFG_SECT_LS5        = "CLA_prog";
memcfg.init_MEMCFG_SECT_MSGCPUTOCLA1 = true;
memcfg.init_MEMCFG_SECT_MSGCLA1TOCPU = true;
